## drivers/misc/mediatek/accelerometer/kxcjk-1013/Kconfig
```kconfig
config MTK_KXCJK1031
	bool "KXCJK1031 for MediaTek package"
	default n
	help
	  It support different accelerometer sensor.
          If this option is set,
	  it will support
          KXCJK1031 Accelerometer.
```

## drivers/misc/mediatek/barometer/lps25h/Kconfig
```kconfig
config MTK_LPS25H
	bool "lps25 for MediaTek package"
	default n
	help
	It support different type sensor
	in this platform. If this option
	is set, it will support pressure
	lps25.
```

## drivers/misc/mediatek/gyroscope/mpu3050c-new/Kconfig
```kconfig
config MTK_MPU3050C_NEW
        bool "ITG1010 for MediaTek package"
        default n
        help
        It support different gyroscope sensor.
        If this option is set,
	  	it will support
         ITG1010 gyroscope.
```

## drivers/misc/mediatek/intercom/Kconfig
```kconfig
config RUNBO_INTERCOM
	tristate "Runbo Intercom driver"
	default n
	---help---
	  Say Y here to support Runbo Intercom.
```

## drivers/misc/mediatek/sn7325/Kconfig
```kconfig
config SN7325_SUPPORT
	bool "IS_SUPPORT_SN7325"
	default n
	help
	  Is support the sn7325 function or not
```
